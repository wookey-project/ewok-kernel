## Kconfig
```kconfig
menu "Board Support Package"

source "kernel/src/arch/Kconfig"

endmenu

#
# Mandatory
#
config ADAKERNEL
  bool
  default y

#
# Serial interface for debugging
#
config KERNEL_SERIAL
  bool "Kernel serial interface activated (debug mode)"
  default n
  ---help---
  This option activates the kernel serial interface (mainly
  for debugging purpose).
  The kernel usart interface is activated.
  Userspace applications printf content will be printed by
  the kernel.
  This should be disabled in production mode.

config KERNEL_MODE
  string
  default "debug"   if KERNEL_SERIAL
  default "release" if !KERNEL_SERIAL

if KERNEL_SERIAL
choice
  prompt "kernel console USART identifier"
  default KERNEL_CONSOLE_USART1
    config KERNEL_CONSOLE_USART1
    bool "kernel uses USART1 for its console"
    ---help---
      In Discovery board, PB6(TX)/PB7(RX) pins are linked to UART1, if
      using motherboard DM-STF4BB, the RS232 connector is linked
      to USART6.
    config KERNEL_CONSOLE_USART4
    bool "kernel uses USART4 for its console"
    ---help---
      In Discovery board, PB6(TX)/PB7(RX) pins are linked to UART1, if
      using motherboard DM-STF4BB, the RS232 connector is linked
      to USART4.
  config KERNEL_CONSOLE_USART6
    bool "kernel uses USART6 for its console"
    ---help---
      In Discovery board, PB6(TX)/PB7(RX) pins are linked to UART1, if
      using motherboard DM-STF4BB, the RS232 connector is linked
      to USART6.
endchoice

config KERNEL_USART
  int
  default 1 if KERNEL_CONSOLE_USART1
  default 4 if KERNEL_CONSOLE_USART4
  default 6 if KERNEL_CONSOLE_USART6

endif

choice
  prompt "Kernel Panic behavior"
  default KERNEL_PANIC_FREEZE
    config KERNEL_PANIC_FREEZE
    bool "Freeze on panic"
    ---help---
       Freeze the system on kernel panic(). This freeze the execution.
       All the software stack is still mapped in flash and RAM. Useful
       for debugging purpose.

    config KERNEL_PANIC_REBOOT
    bool "Reboot on panic"
    ---help---
       Reboot the system on kernel panic(). This force the device to
       reboot but the memory content is zeroified only at boot time.

    config KERNEL_PANIC_WIPE
    bool "Wipe the applications data and reboot"
    ---help---
       Wipe the applications data in RAM with zero and then reboot
       the device. This avoid attacks using panic & reboot action to
       get back the RAM content at early reboot time
endchoice

config KERNEL_DMA_ENABLE
  bool "Enable secure DMA kernel support"
  default y
  ---help---
  This permits to allow tasks to declare DMA stream usage with
  kernel control for address and channel management. If you
  say n here, any DMA declaration will return SYS_E_DENIED.

config KERNEL_GETCYCLES
  bool "Kernel support for DWT-based getcycles()"
  default y
  depends on STM32F4
  select DWT
  ---help---
  Add support for sys_getcycles() syscall, which returns a value
  in cycles instead of ticks, which is more precise.

config KERNEL_DOMAIN
  bool "Kernel support tasks domains"
  default n
  ---help---
  If yes, it is possible to set a specific domain for each task (based on
  a uint8_t value). Task from a same domain can communicate, tasks from
  different domains cannot (no IPC, no shared DMA spaces, get_taskid return
  SYS_E_INVAL, etc.). Each task can declare its domain as 'APP_APPNAME_DOMAIN'
  in the Kconfig system. If no domain is specific, the task is member of the
  default domain 0. Kernel domains has no impact on the scheduling scheme.

menu "Scheduling schemes"

choice
  prompt "Scheduler behavior"
  config SCHED_RR
    bool "Round Robin scheduler"
    ---help---
    This is a classical Round Robin scheduler. ISR are still
    executed with a higher priority than the tasks.
  config SCHED_MLQ_RR
    bool "Multilevel Queue Round Robin"
    ---help---
    This is a basic, multilevel queues scheduling scheme with Round
    Robin scheduling for each queue. As priority as fixed,
    higher priority tasks *must* yield to let other task's main
    thread being executed.
    It is efficient for burst-based, high period and high priority
    tasks such as smartcard management.
  config SCHED_RAND
    bool "Random scheduler"
    ---help---
    Randomly choose a task in the task list at each schedule
    time, using the HW Random number generator.
endchoice

config SCHED_PERIOD
  int "Scheduler period (in milliseconds)"
  default 10
  ---help---
  Set the scheduling period duration. Beware, this value has a huge
  impact on the overall system behavior.

config SCHED_SUPPORT_FISR
  bool "ISR may force immediate one time main thread execution (perm based)"
  default y
  ---help---
  If y, the kernel support the TSK_FISR permission and associated
  behavior. This permit to tasks with this permission to force one single
  immediate schedule of its main thread just after a given ISR which
  as been configured with the flag IRQ_ISR_FORCE_MAINTHREAD.
  This execution slot can still be preempted by a physical IRQ or another
  ISR scheduling.

config SCHED_SUPPORT_FIPC
  bool "IPC send may force immediate one time target task execution (perm based)"
  default n
  ---help---
  If y, the kernel support the TSK_FIPC permission and associated behavior.
  This permit to a task sending an IPC with reactivity constraint to force
  one signe immediate schedule of the target task, if this task is waiting for
  this IPC only. This highly reduce IPC latency but is still a scheduling violation.
  This execution slot can still be preempted by a physical IRQ or another
  ISR scheduling.

endmenu

choice
  prompt "Kernel specific build size selection"
  default KERN_OPTIM_SIZE
  config KERN_OPTIM_SIZE
    bool "Optimized for size (-Os)"
  config KERN_OPTIM_HYBRID
    bool "Optimized for size (-Os) and for performance for critical modules (-O2)"
  config KERN_OPTIM_PERF
    bool "Optimized for perf (-O2)"
endchoice

config KERN_CFLAGS
  string
  default "-O2" if KERN_OPTIM_PERF
  default "-Os" if KERN_OPTIM_HYBRID
  default "-Os" if KERN_OPTIM_SIZE

config KERNEL_ADA_BUILDSIZE
  string
  default "perf" if KERN_OPTIM_PERF
  default "hybrid" if KERN_OPTIM_HYBRID
  default "size" if KERN_OPTIM_SIZE



menu "Kernel hacking"

config KERNEL_SOFTIRQ_QUEUE_DEPTH
  int "Kernel softirq input queue depth"
  range 16 128
  default 20
  ---help---
  Specify the maximum number of ISR waiting to be executed at a given time.
  This value can be increased up to 64 depending on the devices behavior,
  if there interrupt bursts arrise, generating queue overflow.
  The kernel consider a queue overflow as a critical event and panic.



config DBGLEVEL
  int "Set debug level"
  default 3
  help
    Set the debug level for pretty printing at runtime. This respects
    the syslog levels standard:
      0: EMERG
      1: ALERT
      2: CRITICAL
      3: ERROR
      4: WARNING
      5: NOTICE
      6: INFORMATIONAL
      7: DEBUG
    All debug levels less or equal to the chosen level will be printed.

config DEBUG
  bool "Set debug compile flags"
  default n
  help
    if set, the project will be compiled using debug flags and without
    compile-time optimization.

config KERNEL_SCHED_DEBUG
  bool "Activate scheduler debugging"
  default n
  help
    If set, the scheduler will store in a ring buffer all thread execution
    using the following structure:
      [ id | timestamp (us) | mode (ISR,MR) ]
    The ringbuffer is never printed-out to avoid any time overhead. Yet it
    can be dumped by gdb at anytime

if KERNEL_SCHED_DEBUG

config KERNEL_SCHED_DEBUG_BUFSIZE
  int "Scheduling buffer size"
  default 1000
  help
    Set the ring buffer base address. Beware, you must set a writeable address
    in RAM where no content is being stored)



endif

config KERNEL_EXPERT_MODE
  bool "Configure EwoK in expert mode"
  default n
  ---help---
  Make complex options visible. Beware when modifying
  these options. They may have a great impact on the
  kernel behavior and make the overall system unstable!!!

if KERNEL_EXPERT_MODE

  config KERNEL_EXP_REENTRANCY
  bool "(Experimental) Enable handler mode reentrancy support"
  default n
  ---help---
  Make kernel interruption handling reentrant to support
  IRQ preemptions and handling reentrancy based on hardware
  interrupts priorities
endif

endmenu

# Ewok kernel. Require its stdlib
config KERNEL_EWOK
   bool
   select USR_LIB_STD
   default y
```

## src/arch/Kconfig
```kconfig
# This is the arch-specific / board-specific configuration file.
# This file describes all the configuration menu "Target configuration".
#

menu "Board setup"

choice
  prompt "Target board"
  config DISCO407
    bool "Support for 32F429IDISCOVERY board"
    select STACK_PROT_FLAG
    select STM32F407
    help
      Compile for the Discovery 32F407I board.
      No Cryp support, 1MB flash bank.
  config DISCO429
    bool "Support for 32F407IDISCOVERY board"
    select STACK_PROT_FLAG
    select STM32F429
    help
      Compile for the Discovery 32F429I board.
      Cryp support, 1MB flash bank.
  config WOOKEY
    bool "Support for WOOKEY board"
    select STACK_PROT_FLAG
    select STM32F439
    help
      Compile for the Wookey v1 board.
endchoice

if WOOKEY

choice
  prompt "Wookey board release"
  config WOOKEY_V1
    bool "Support for Wookey v1 layout"
    help
      Select Wookey v1 layouting (GPIO mapping, peripheral listing...)
  config WOOKEY_V2
    bool "Support for Wookey v2 layout"
    help
      Select Wookey v2 layouting (GPIO mapping, peripheral listing...)
endchoice

endif

endmenu

# defining board release suffix. Used for Wookey as the wookey board as
# multiple releases. Discovery boards haven't.
config BOARD_RELEASE
   string
   default "v1" if WOOKEY_V1
   default "v2" if WOOKEY_V2
   default "" if DISCO407 || DISCO429

menu "SoC and Core setup"

# most of kernel code is generic to multiple SoC familly, such as STM32F4 in this
# case. When there is a specificity (for e.g. flash layout), please use STM32F429 or
# STM32F439 config unit to differenciate
config STM32F4
  bool
  default n


# hierarchical selection from board selection. Silent config
config STM32F407
    bool
    select STM32F4_SPI
    select ARCH_ARMV7M
    select ARCH_CORTEX_M4
    select STM32F4

config STM32F429
    bool
    select STM32F4_SPI
    select ARCH_ARMV7M
    select ARCH_CORTEX_M4
    select STM32F4

config STM32F439
    bool
    select STM32F4_SPI
    select ARCH_ARMV7M
    select ARCH_CORTEX_M4
    select STM32F4

if DISCO407
source "kernel/src/arch/socs/stm32f407/Kconfig"
endif

if DISCO429
source "kernel/src/arch/socs/stm32f429/Kconfig"
endif

if WOOKEY
source "kernel/src/arch/socs/stm32f439/Kconfig"
endif

config CORE_FREQUENCY
  int "Target core frequency"
  depends on STM32F4 || STM32F2
  default 168000
  help
    Specify the Cortex-M core frequency

endmenu

# hidden config, selected by others
# This configurations are not visible to user and are automaticaly set at configuration
# time, depending on the choices above.
# all these generates Makefile helper variables

config ARCH_ARMV7M
    bool
    default n

config ARCH_CORTEX_M4
    bool
    default n

config ARCH_CORTEX_M3
    bool
    default n

config ARCH
    string
    default "armv7-m" if STM32F4 || STM32F2

config ADA_ARCH
    string
    depends on ADAKERNEL
    default "arm-eabi" if ARCH_ARMV7M

config ADA_PROFILE
    string
    depends on ADAKERNEL
    default "zfp-stm32f4" if STM32F4 || STM32F2
    default "zfp-rpi2" if RPI2

config BOARDNAME
    string
    default "wookey" if WOOKEY
    default "32f407discovery" if DISCO407
    default "32f429discovery" if DISCO429

config SOCNAME
    string
    default "stm32f429" if STM32F429
    default "stm32f439" if STM32F439
    default "stm32f407" if STM32F407

config CORENAME
    string
    default "cortex-m4" if STM32F4
    default "cortex-m3" if STM32F2

# define the max number of task slots
config MAXTASKS
    int
    default 8 if STM32F4
    default 8 if STM32F2

config AFLAGS_GCC
    string
    default "-mlittle-endian -mthumb -mcpu=cortex-m4 -mfloat-abi=hard -mfpu=fpv4-sp-d16 -fPIC -fpie" if STM32F4
    default "-mlittle-endian -mthumb -mcpu=cortex-m4 -mfloat-abi=hard -mfpu=fpv4-sp-d16 -fPIC -fpie" if STM32F2

config AFLAGS_LLVM
    string
    default "--target=thumbv7m-none-eabi -mcpu=cortex-m4 -mfloat-abi=hard -mfpu=fpv4-sp-d16 -mthumb -fPIC -fpie" if STM32F4
    default "--target=arm-none-eabi -mcpu=cortex-m4 -mfloat-abi=hard -mfpu=fpv4-sp-d16 -mthumb -fPIC -fpie" if STM32F2
```
