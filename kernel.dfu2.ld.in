/* fwx.ld */

INCLUDE BUILDDIR/layout.ld

_estack = _kern_init_msp_stack;

/* Define output sections */
SECTIONS
{
  /* The startup code goes first into FLASH */
  .isr_vector :
  {
    . = ALIGN(4);
    KEEP(*(.isr_vector)) /* Startup code */
    . = ALIGN(4);
  }>DFU2_KERN

  /* The program code and other data goes into FLASH */
  .text :
  {
    _stext = .;	            /* create a global symbol at data start */
    *startup*(.text.Reset_Handler)
    *(.text*)
    *(.rodata)         	/* .rodata sections (constants, strings, etc.) */
    *(.rodata*)         	/* .rodata sections (constants, strings, etc.) */
    *(.glue_7)         	/* glue arm to thumb code */
    *(.glue_7t)        	/* glue thumb to arm code */
	*(.eh_frame)

    KEEP (*(.init))
    KEEP (*(.fini))

    . = ALIGN(4);
    _etext = .;        	/* define a global symbols at end of code */
    _exit = .;
  }>DFU2_KERN

  /* used by the startup to initialize got */
  _sigot = .;
  .got : AT ( _sigot ) {
    . = ALIGN(4);
        _sgot = .;
        /*  *(.got.plt)
         *    We don't need plt segment
         *    since we do not need dynamic library relocation
         */
        *(.got)
        *(.got*)
    . = ALIGN(4);
    _egot = .;
  }>DFU2_KERN
  /* used by the startup to initialize data */
  _sidata = .;
  /* Initialized data sections goes into RAM, load LMA copy after code */
  .data : AT ( _sidata )
  {
    . = ALIGN(4);
    _sdata = .;        /* create a global symbol at data start */
    *(.data)           /* .data sections */
    *(.data*)          /* .data* sections */
    _edata = .;        /* define a global symbol at data end */
  }>RAM_KERN

  /* Shared variables */
  .shared :    {
    . = ALIGN(4);
    KEEP(*(.shared)) ;
  }>SHR


  /* Uninitialized data section */
  . = ALIGN(4);
  .bss :
  {
    /* This is used by the startup in order to initialize the .bss section */
    _sbss = .;         /* define a global symbol at bss start */
    __bss_start__ = _sbss;
    *debug.o(.bss)
    *(.bss)
    *(.bss*)
    *(COMMON)

    . = ALIGN(4);
    _ebss = .;         /* define a global symbol at bss end */
    __bss_end__ = _ebss;
  }>RAM_KERN

    /* heap_stack section, used to check that there is enough RAM left */
  ._heap_stack :
  {
    . = ALIGN(4);
    PROVIDE ( end = . );
    PROVIDE ( _end = . );
    . = . + 4096; /* kernel idle thread stack */
    . = . + 4096; /* kernel initial thread stack */
    . = . + 8192; /* softirq thread stack */
    . = . + 4096; /* user ISR stack (remapped region) */
    . = ALIGN(4);
  }>RAM_KERN

  /* Remove information from the standard libraries */
  /DISCARD/ :
  {
    libgcc.a ( * )
  }

}
